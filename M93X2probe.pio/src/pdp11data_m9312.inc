/* ..\M93X2probe.pio\src\pdp11data_m9312.inc - format records to hold loadable PDP-11 binary code
   Loads only into first 56k page
   Platform    : Arduino
   Memory space: PROGMEM
   Generated by: pdp11code2c -ml odt07.lst -cs ..\M93X2probe.pio\src\pdp11data_m9312.inc -cid m9312RecordList --entryaddress DIAG
   Generated at: 2024-07-25 14:27:25
   Contact     : ioerg.hoppe@gmail.com
*/
#include "pdp11data.h"

/* define non-contiguous blocks */
static const PROGMEM Pdp11DataRecord m9312RecordListRecord00 = {
    0010000,     // start address
    23     ,     // word count
    /* 0010000: */ 0010000, 0010000, 0100000, 0177777, 0010006, 0010006, 0000500, 0000501, 
    /* 0010020: */ 0005003, 0005203, 0005103, 0006203, 0006303, 0006003, 0005703, 0005403, 
    /* 0010040: */ 0005303, 0005603, 0006103, 0005503, 0000303, 0001377, 0000433
};

static const PROGMEM Pdp11DataRecord m9312RecordListRecord01 = {
    0010144,     // start address
    129    ,     // word count
    /* 0010144: */ 0010701, 0000546, 0010701, 0000520, 0010400, 0000516, 0010600, 0010701, 
    /* 0010164: */ 0000513, 0010500, 0000511, 0010605, 0010701, 0000532, 0112702, 0000100, 
    /* 0010204: */ 0010703, 0000545, 0010706, 0000535, 0000302, 0000533, 0020227, 0046040, 
    /* 0010224: */ 0001442, 0020402, 0001001, 0005725, 0010204, 0020227, 0042440, 0001440, 
    /* 0010244: */ 0020227, 0042040, 0001424, 0020227, 0051415, 0001002, 0000005, 0000115, 
    /* 0010264: */ 0010704, 0062704, 0000512, 0021427, 0017777, 0001722, 0022402, 0001402, 
    /* 0010304: */ 0061404, 0000771, 0010701, 0000417, 0000005, 0000164, 0000010, 0010701, 
    /* 0010324: */ 0000412, 0010015, 0000721, 0010701, 0000406, 0010005, 0005004, 0000714, 
    /* 0010344: */ 0010506, 0011505, 0000703, 0005000, 0005002, 0010703, 0000452, 0120227, 
    /* 0010364: */ 0000015, 0001433, 0162702, 0000070, 0062702, 0000010, 0103357, 0006300, 
    /* 0010404: */ 0006300, 0006300, 0050200, 0000760, 0012702, 0000030, 0000261, 0006100, 
    /* 0010424: */ 0106102, 0010703, 0000434, 0012702, 0020206, 0006300, 0001403, 0106102, 
    /* 0010444: */ 0103774, 0000765, 0000302, 0010703, 0000422, 0022121, 0000161, 0177776, 
    /* 0010464: */ 0012702, 0000015, 0010703, 0000413, 0012702, 0000012, 0010703, 0000407, 
    /* 0010504: */ 0000764, 0105737, 0177560, 0100375, 0105002, 0153702, 0177562, 0105737, 
    /* 0010524: */ 0177564, 0100375, 0110237, 0177566, 0142702, 0100200, 0022323, 0000163, 
    /* 0010544: */ 0177776
};

static const PROGMEM Pdp11DataRecord m9312RecordListRecord02 = {
    0010564,     // start address
    1      ,     // word count
    /* 0010564: */ 0000000
};

static const PROGMEM Pdp11DataRecord m9312RecordListRecord03 = {
    0010774,     // start address
    131    ,     // word count
    /* 0010774: */ 0040460, 0123162, 0042114, 0000176, 0000261, 0012700, 0000000, 0012701, 
    /* 0011014: */ 0174400, 0010704, 0000240, 0000402, 0173000, 0000340, 0010003, 0000303, 
    /* 0011034: */ 0010311, 0012761, 0000013, 0000004, 0052703, 0000004, 0010311, 0105711, 
    /* 0011054: */ 0100376, 0105003, 0052703, 0000010, 0010311, 0105711, 0100376, 0016102, 
    /* 0011074: */ 0000006, 0042702, 0000077, 0005202, 0010261, 0000004, 0105003, 0052703, 
    /* 0011114: */ 0000006, 0010311, 0105711, 0100376, 0005061, 0000004, 0012761, 0177000, 
    /* 0011134: */ 0000006, 0105003, 0052703, 0000014, 0010311, 0105711, 0100376, 0005711, 
    /* 0011154: */ 0100003, 0000005, 0000164, 0000002, 0042711, 0000377, 0005007, 0000137, 
    /* 0011174: */ 0165564, 0171540, 0042131, 0000176, 0000261, 0012700, 0000000, 0012701, 
    /* 0011214: */ 0177170, 0010704, 0000240, 0000402, 0173000, 0000340, 0005103, 0000005, 
    /* 0011234: */ 0012704, 0000401, 0005002, 0012705, 0000200, 0042703, 0177377, 0001001, 
    /* 0011254: */ 0006205, 0050700, 0156003, 0000036, 0040700, 0010706, 0000423, 0000432, 
    /* 0011274: */ 0000416, 0000415, 0000425, 0000430, 0000407, 0060502, 0060502, 0122424, 
    /* 0011314: */ 0120427, 0013407, 0003756, 0005007, 0010261, 0000002, 0000403, 0110461, 
    /* 0011334: */ 0000002, 0000304, 0032711, 0100240, 0001775, 0100630, 0005726, 0000116, 
    /* 0011354: */ 0042703, 0000004, 0010311, 0000766, 0110561, 0000002, 0000763, 0000137, 
    /* 0011374: */ 0165564, 0057141, 0017777
};

/* Link all records into one list */
const PROGMEM Pdp11DataRecordList m9312RecordList = {
    0010020,    // execution entry address
    4      ,    // record count
    &m9312RecordListRecord00,
    &m9312RecordListRecord01,
    &m9312RecordListRecord02,
    &m9312RecordListRecord03
};

