/* ..\M93X2probe.pio\src\pdp11data_basic.inc - format records to hold loadable PDP-11 binary code
   Loads only into first 56k page
   Platform    : Arduino
   Memory space: PROGMEM
   Generated by: pdp11code2c -pt DEC-11-AJPB-PB.ptap -cs ..\M93X2probe.pio\src\pdp11data_basic.inc -cid basicRecordList
   Generated at: 2024-07-25 14:27:25
   Contact     : ioerg.hoppe@gmail.com
*/
#include "pdp11data.h"

/* define non-contiguous blocks */
static const PROGMEM Pdp11DataRecord basicRecordListRecord00 = {
    0000000,     // start address
    16     ,     // word count
    /* 0000000: */ 0000167, 0003040, 0000006, 0000000, 0000012, 0000000, 0000016, 0000000, 
    /* 0000020: */ 0000022, 0000000, 0000026, 0000000, 0000032, 0000000, 0000100, 0000000
};

static const PROGMEM Pdp11DataRecord basicRecordListRecord01 = {
    0000042,     // start address
    1      ,     // word count
    /* 0000042: */ 0040407
};

static const PROGMEM Pdp11DataRecord basicRecordListRecord02 = {
    0000050,     // start address
    3975   ,     // word count
    /* 0000050: */ 0000056, 0000137, 0000056, 0104465, 0001136, 0000000, 0000066, 0000000, 
    /* 0000070: */ 0000072, 0000000, 0000076, 0000000, 0011666, 0000002, 0162716, 0000002, 
    /* 0000110: */ 0013646, 0006216, 0103404, 0006316, 0062716, 0073654, 0013607, 0042716, 
    /* 0000130: */ 0177600, 0012602, 0020227, 0000100, 0003011, 0005067, 0013526, 0012767, 
    /* 0000150: */ 0000001, 0013524, 0016706, 0013532, 0012746, 0004122, 0010146, 0010201, 
    /* 0000170: */ 0012700, 0000233, 0010146, 0104412, 0104402, 0012700, 0000226, 0104466, 
    /* 0000210: */ 0104404, 0104402, 0005726, 0001001, 0104516, 0012601, 0000207, 0051105, 
    /* 0000230: */ 0047522, 0020122, 0020040, 0020040, 0020040, 0052101, 0046040, 0047111, 
    /* 0000250: */ 0020105, 0000000, 0000476, 0000574, 0002312, 0010074, 0011440, 0011506, 
    /* 0000270: */ 0011566, 0011752, 0012216, 0012442, 0012500, 0012550, 0012776, 0013310, 
    /* 0000310: */ 0013324, 0013166, 0013476, 0013470, 0014646, 0014744, 0014666, 0014536, 
    /* 0000330: */ 0013354, 0014662, 0016016, 0011776, 0012036, 0000606, 0000430, 0001224, 
    /* 0000350: */ 0001656, 0001620, 0000644, 0001646, 0002126, 0002010, 0001236, 0001340, 
    /* 0000370: */ 0001436, 0001256, 0001610, 0001536, 0001772, 0001724, 0002346, 0002144, 
    /* 0000410: */ 0002362, 0004574, 0002400, 0002414, 0006010, 0001302, 0001322, 0017012, 
    /* 0000430: */ 0020227, 0000060, 0002415, 0020227, 0000071, 0003002, 0000264, 0000207, 
    /* 0000450: */ 0020227, 0000101, 0002405, 0020227, 0000132, 0003002, 0000257, 0000207, 
    /* 0000470: */ 0000257, 0000262, 0000207, 0010146, 0012701, 0177564, 0005767, 0013166, 
    /* 0000510: */ 0001403, 0016701, 0013170, 0000416, 0005267, 0013146, 0026727, 0013142, 
    /* 0000530: */ 0000110, 0003405, 0010246, 0010046, 0104402, 0012600, 0012602, 0005767, 
    /* 0000550: */ 0013126, 0001406, 0005267, 0013130, 0105711, 0100374, 0110261, 0000002, 
    /* 0000570: */ 0012601, 0000207, 0012767, 0177776, 0013070, 0012700, 0004103, 0112002, 
    /* 0000610: */ 0001770, 0104400, 0000774, 0005767, 0013052, 0001012, 0022703, 0013540, 
    /* 0000630: */ 0103005, 0012702, 0000134, 0104400, 0005303, 0000402, 0012703, 0013540, 
    /* 0000650: */ 0005767, 0013020, 0001437, 0005067, 0013016, 0016702, 0013016, 0020227, 
    /* 0000670: */ 0177560, 0001002, 0005067, 0176660, 0105212, 0005267, 0013002, 0005712, 
    /* 0000710: */ 0100502, 0105712, 0100372, 0016202, 0000002, 0001752, 0042702, 0177600, 
    /* 0000730: */ 0120227, 0000020, 0001457, 0122702, 0000015, 0001011, 0104402, 0012702, 
    /* 0000750: */ 0000012, 0000417, 0005067, 0176600, 0012702, 0177560, 0000746, 0122702, 
    /* 0000770: */ 0000177, 0001711, 0122702, 0000140, 0003445, 0122702, 0000025, 0001422, 
    /* 0001010: */ 0104400, 0110223, 0120227, 0000012, 0001404, 0020327, 0013657, 0103710, 
    /* 0001030: */ 0104431, 0012701, 0013540, 0012767, 0000001, 0012634, 0052767, 0000100, 
    /* 0001050: */ 0176506, 0000207, 0112702, 0000136, 0104400, 0112702, 0000125, 0104400, 
    /* 0001070: */ 0104402, 0000664, 0012767, 0000100, 0176456, 0005046, 0012746, 0003056, 
    /* 0001110: */ 0010246, 0000423, 0104407, 0005067, 0012552, 0012767, 0000001, 0012550, 
    /* 0001130: */ 0005726, 0000167, 0001754, 0010246, 0116702, 0176416, 0042702, 0177600, 
    /* 0001150: */ 0120227, 0000020, 0001402, 0012602, 0000002, 0016746, 0012512, 0012767, 
    /* 0001170: */ 0000001, 0012504, 0012702, 0000136, 0104400, 0012702, 0000120, 0104400, 
    /* 0001210: */ 0012667, 0012464, 0012767, 0000001, 0012460, 0000755, 0112102, 0122702, 
    /* 0001230: */ 0000040, 0001774, 0000207, 0121127, 0000072, 0001404, 0122127, 0000012, 
    /* 0001250: */ 0001372, 0005301, 0000207, 0005067, 0012406, 0005767, 0012400, 0001404, 
    /* 0001270: */ 0016705, 0012372, 0005067, 0012366, 0000207, 0104512, 0005000, 0104512, 
    /* 0001310: */ 0010500, 0104512, 0104512, 0104512, 0000207, 0010200, 0104512, 0010300, 
    /* 0001330: */ 0104512, 0010400, 0104512, 0000207, 0010446, 0010504, 0062704, 0000024, 
    /* 0001350: */ 0020406, 0103014, 0005767, 0012306, 0001006, 0010567, 0012300, 0005205, 
    /* 0001370: */ 0006205, 0000241, 0006305, 0010025, 0012604, 0000207, 0104401, 0011300, 
    /* 0001410: */ 0041600, 0020004, 0001423, 0042700, 0017777, 0022700, 0040000, 0001022, 
    /* 0001430: */ 0062703, 0000020, 0000406, 0005703, 0001414, 0020506, 0103357, 0010146, 
    /* 0001450: */ 0010046, 0020306, 0103353, 0020305, 0103752, 0005003, 0012600, 0012601, 
    /* 0001470: */ 0005703, 0000207, 0003005, 0062703, 0000002, 0062703, 0000004, 0000761, 
    /* 0001510: */ 0005700, 0001402, 0005723, 0000755, 0116300, 0000002, 0116301, 0000003, 
    /* 0001530: */ 0104522, 0060003, 0000762, 0042700, 0177400, 0042701, 0177400, 0005200, 
    /* 0001550: */ 0005201, 0010446, 0010346, 0104416, 0012603, 0012604, 0005701, 0001006, 
    /* 0001570: */ 0020027, 0022000, 0103003, 0104530, 0000257, 0000207, 0000262, 0000207, 
    /* 0001610: */ 0010301, 0010102, 0060401, 0000404, 0104516, 0010103, 0010102, 0104502, 
    /* 0001630: */ 0020105, 0103002, 0112123, 0000774, 0010305, 0010201, 0000207, 0122127, 
    /* 0001650: */ 0000012, 0001375, 0000207, 0016701, 0012000, 0104502, 0020105, 0103013, 
    /* 0001670: */ 0010046, 0010146, 0104410, 0012601, 0010002, 0012600, 0020002, 0001402, 
    /* 0001710: */ 0003364, 0000257, 0000207, 0000257, 0000262, 0000207, 0104472, 0104470, 
    /* 0001730: */ 0001416, 0102415, 0042702, 0177700, 0010204, 0000304, 0006204, 0006204, 
    /* 0001750: */ 0104472, 0104470, 0001002, 0050204, 0104472, 0000257, 0000207, 0000262, 
    /* 0001770: */ 0000207, 0005700, 0002746, 0020027, 0000377, 0003343, 0000264, 0000207, 
    /* 0002010: */ 0104472, 0104470, 0001015, 0005301, 0104410, 0010046, 0104472, 0022702, 
    /* 0002030: */ 0000054, 0001010, 0104410, 0005700, 0001405, 0010004, 0012603, 0000207, 
    /* 0002050: */ 0005046, 0000765, 0005004, 0000772, 0012767, 0000001, 0011610, 0000167, 
    /* 0002070: */ 0000346, 0012767, 0000001, 0011574, 0016705, 0011556, 0005205, 0005067, 
    /* 0002110: */ 0011554, 0005067, 0011564, 0005067, 0011536, 0000167, 0000634, 0010504, 
    /* 0002130: */ 0060004, 0010603, 0162703, 0000070, 0020304, 0000207, 0010346, 0104536, 
    /* 0002150: */ 0102437, 0121127, 0000054, 0001041, 0004767, 0000102, 0104472, 0010046, 
    /* 0002170: */ 0104536, 0102033, 0104440, 0100432, 0012602, 0017604, 0000000, 0042704, 
    /* 0002210: */ 0177400, 0020004, 0003023, 0010146, 0010201, 0010046, 0010400, 0005200, 
    /* 0002230: */ 0104416, 0062600, 0104530, 0012601, 0061600, 0005720, 0012603, 0000207, 
    /* 0002250: */ 0004767, 0000012, 0010002, 0005000, 0000750, 0104413, 0104415, 0104440, 
    /* 0002270: */ 0100775, 0017604, 0000002, 0000304, 0042704, 0177400, 0020004, 0003366, 
    /* 0002310: */ 0000207, 0162706, 0000010, 0010600, 0016701, 0011334, 0104412, 0010600, 
    /* 0002330: */ 0005720, 0105066, 0000007, 0104466, 0062706, 0000010, 0000207, 0000241, 
    /* 0002350: */ 0006300, 0010046, 0006300, 0062600, 0000207, 0016703, 0011300, 0005203, 
    /* 0002370: */ 0006203, 0000241, 0006303, 0000207, 0104472, 0010204, 0000304, 0104472, 
    /* 0002410: */ 0050204, 0000207, 0010346, 0010246, 0016646, 0000004, 0010466, 0000006, 
    /* 0002430: */ 0020506, 0103001, 0000207, 0104401, 0104516, 0104506, 0010300, 0001060, 
    /* 0002450: */ 0016703, 0011206, 0005704, 0001062, 0010504, 0005767, 0011214, 0001076, 
    /* 0002470: */ 0112302, 0120227, 0000140, 0002421, 0162702, 0000140, 0012700, 0003626, 
    /* 0002510: */ 0010201, 0005301, 0002404, 0122027, 0000044, 0001375, 0000772, 0112002, 
    /* 0002530: */ 0120227, 0000044, 0001752, 0104400, 0000772, 0120227, 0000012, 0001402, 
    /* 0002550: */ 0104400, 0000743, 0104402, 0020304, 0103740, 0005767, 0011110, 0001406, 
    /* 0002570: */ 0005002, 0012701, 0000100, 0104400, 0005301, 0001375, 0000167, 0000276, 
    /* 0002610: */ 0010446, 0104474, 0012604, 0020105, 0101313, 0010103, 0020400, 0003407, 
    /* 0002630: */ 0010400, 0010346, 0104474, 0001006, 0012603, 0020105, 0101305, 0104502, 
    /* 0002650: */ 0010104, 0000703, 0012603, 0020105, 0101277, 0000772, 0000167, 0000166, 
    /* 0002670: */ 0104516, 0104506, 0016701, 0010762, 0005704, 0001001, 0010304, 0010446, 
    /* 0002710: */ 0010346, 0104502, 0020105, 0103012, 0010146, 0104410, 0012601, 0020016, 
    /* 0002730: */ 0002770, 0020066, 0000002, 0003002, 0104476, 0000764, 0022626, 0000461, 
    /* 0002750: */ 0104516, 0104474, 0001013, 0104476, 0000411, 0004767, 0176236, 0122702, 
    /* 0002770: */ 0000072, 0001520, 0122702, 0000012, 0001401, 0104407, 0005767, 0010654, 
    /* 0003010: */ 0001445, 0005767, 0010650, 0001403, 0020167, 0010642, 0000401, 0020105, 
    /* 0003030: */ 0103114, 0004767, 0006402, 0010067, 0010616, 0000474, 0016705, 0010612, 
    /* 0003050: */ 0005205, 0005067, 0010610, 0016706, 0010630, 0005067, 0010606, 0005067, 
    /* 0003070: */ 0010610, 0005067, 0010562, 0012767, 0000001, 0010574, 0104402, 0005067, 
    /* 0003110: */ 0010564, 0005067, 0010546, 0012700, 0004076, 0104466, 0005067, 0010552, 
    /* 0003130: */ 0104500, 0104472, 0020227, 0000012, 0001771, 0012701, 0013540, 0104410, 
    /* 0003150: */ 0121127, 0000012, 0001675, 0010103, 0012700, 0003626, 0005002, 0122327, 
    /* 0003170: */ 0000040, 0001775, 0124320, 0001005, 0005203, 0121027, 0000044, 0001430, 
    /* 0003210: */ 0000766, 0122027, 0000044, 0001375, 0121027, 0000044, 0001420, 0010103, 
    /* 0003230: */ 0005202, 0000755, 0005767, 0010442, 0001306, 0004767, 0175756, 0162702, 
    /* 0003250: */ 0000140, 0100405, 0006302, 0000172, 0004020, 0000167, 0000620, 0104403, 
    /* 0003270: */ 0062702, 0000140, 0110221, 0010104, 0111321, 0122327, 0000012, 0001374, 
    /* 0003310: */ 0120227, 0000143, 0001465, 0020227, 0000155, 0001035, 0010401, 0104472, 
    /* 0003330: */ 0120227, 0000124, 0001022, 0104472, 0120227, 0000110, 0001016, 0104472, 
    /* 0003350: */ 0120227, 0000105, 0001012, 0104472, 0120227, 0000116, 0001006, 0104472, 
    /* 0003370: */ 0005301, 0010104, 0104470, 0001407, 0000666, 0120227, 0000012, 0001430, 
    /* 0003410: */ 0120227, 0000072, 0001344, 0010401, 0121127, 0000042, 0001410, 0122127, 
    /* 0003430: */ 0000072, 0001755, 0124127, 0000012, 0001412, 0005201, 0000765, 0005201, 
    /* 0003450: */ 0121127, 0000042, 0001772, 0121127, 0000012, 0001371, 0104463, 0005201, 
    /* 0003470: */ 0010103, 0012701, 0013540, 0104472, 0104470, 0001402, 0005301, 0000652, 
    /* 0003510: */ 0104516, 0012701, 0013540, 0160103, 0010346, 0104410, 0005700, 0001436, 
    /* 0003530: */ 0020027, 0017777, 0003033, 0104474, 0001001, 0104476, 0012603, 0104516, 
    /* 0003550: */ 0010300, 0104504, 0103003, 0104401, 0060005, 0000410, 0020105, 0103374, 
    /* 0003570: */ 0010502, 0060005, 0010504, 0114244, 0020102, 0101775, 0012702, 0013540, 
    /* 0003610: */ 0111221, 0122227, 0000012, 0001374, 0000167, 0177160, 0104441, 0044514, 
    /* 0003630: */ 0052123, 0046044, 0052105, 0051044, 0040505, 0022104, 0042522, 0022115, 
    /* 0003650: */ 0052522, 0022116, 0042522, 0052123, 0051117, 0022105, 0042522, 0052524, 
    /* 0003670: */ 0047122, 0042044, 0052101, 0022101, 0044504, 0022115, 0042504, 0042514, 
    /* 0003710: */ 0042524, 0050044, 0044522, 0052116, 0043444, 0051517, 0041125, 0043444, 
    /* 0003730: */ 0052117, 0022117, 0043111, 0043044, 0051117, 0047044, 0054105, 0022124, 
    /* 0003750: */ 0047111, 0052520, 0022124, 0040523, 0042526, 0051444, 0047524, 0022120, 
    /* 0003770: */ 0047105, 0022104, 0042504, 0022106, 0046117, 0022104, 0040522, 0042116, 
    /* 0004010: */ 0046517, 0055111, 0022105, 0000044, 0002440, 0006070, 0007150, 0006324, 
    /* 0004030: */ 0004150, 0004240, 0004246, 0006324, 0004332, 0002670, 0006430, 0004204, 
    /* 0004050: */ 0004216, 0006140, 0007302, 0007620, 0006660, 0002060, 0004106, 0004106, 
    /* 0004070: */ 0004474, 0002072, 0010054, 0042522, 0042101, 0006531, 0000012, 0104402, 
    /* 0004110: */ 0012700, 0004132, 0104466, 0104404, 0104402, 0005067, 0007532, 0000167, 
    /* 0004130: */ 0176760, 0052123, 0050117, 0040440, 0020124, 0044514, 0042516, 0000040, 
    /* 0004150: */ 0104516, 0005067, 0007502, 0016701, 0007500, 0005201, 0012767, 0013507, 
    /* 0004170: */ 0003656, 0012767, 0000001, 0007464, 0000167, 0176600, 0016700, 0007450, 
    /* 0004210: */ 0052700, 0020000, 0104512, 0104410, 0104474, 0001005, 0012767, 0000001, 
    /* 0004230: */ 0007432, 0000167, 0176574, 0104405, 0005067, 0007424, 0000507, 0005046, 
    /* 0004250: */ 0012704, 0020000, 0104534, 0001424, 0012700, 0017777, 0104514, 0001403, 
    /* 0004270: */ 0010316, 0005723, 0000773, 0012603, 0001413, 0011300, 0040400, 0005200, 
    /* 0004310: */ 0012704, 0000002, 0104520, 0020027, 0000001, 0001677, 0104474, 0000736, 
    /* 0004330: */ 0104411, 0104544, 0102427, 0001055, 0010446, 0104472, 0020227, 0000050, 
    /* 0004350: */ 0001021, 0104410, 0104524, 0001016, 0010046, 0000316, 0104472, 0120227, 
    /* 0004370: */ 0000054, 0001005, 0104410, 0104524, 0001005, 0050016, 0104472, 0020227, 
    /* 0004410: */ 0000051, 0001401, 0104433, 0012602, 0012600, 0010146, 0104512, 0010200, 
    /* 0004430: */ 0104512, 0010201, 0000301, 0104522, 0102413, 0104504, 0103411, 0060005, 
    /* 0004450: */ 0012601, 0104472, 0020227, 0000054, 0001724, 0005301, 0000167, 0176272, 
    /* 0004470: */ 0104435, 0104443, 0104540, 0020427, 0043116, 0001033, 0104472, 0104470, 
    /* 0004510: */ 0001430, 0102427, 0052702, 0060000, 0010200, 0104512, 0104472, 0020227, 
    /* 0004530: */ 0000050, 0001017, 0104526, 0102415, 0010400, 0104512, 0020227, 0000051, 
    /* 0004550: */ 0001010, 0104472, 0020227, 0000075, 0001004, 0010100, 0104512, 0104510, 
    /* 0004570: */ 0000735, 0104437, 0005000, 0104512, 0012746, 0177777, 0104504, 0103561, 
    /* 0004610: */ 0104472, 0020227, 0000053, 0001410, 0020227, 0000055, 0001006, 0010200, 
    /* 0004630: */ 0005002, 0005003, 0005004, 0000410, 0104472, 0020227, 0000050, 0001007, 
    /* 0004650: */ 0005046, 0005265, 0177776, 0000752, 0104542, 0010046, 0000765, 0005301, 
    /* 0004670: */ 0014546, 0004767, 0000302, 0012625, 0010246, 0104472, 0012700, 0005163, 
    /* 0004710: */ 0124002, 0001407, 0020027, 0005155, 0101373, 0005000, 0005301, 0012602, 
    /* 0004730: */ 0000402, 0010200, 0000774, 0005716, 0003457, 0010146, 0012701, 0005163, 
    /* 0004750: */ 0124100, 0001376, 0006201, 0010125, 0012701, 0005163, 0124166, 0000002, 
    /* 0004770: */ 0001375, 0006201, 0010125, 0012601, 0024545, 0002726, 0010025, 0012700, 
    /* 0005010: */ 0005163, 0124016, 0001376, 0162700, 0005156, 0006300, 0062700, 0005164, 
    /* 0005030: */ 0010025, 0005726, 0010600, 0104542, 0010146, 0010601, 0005721, 0014502, 
    /* 0005050: */ 0014546, 0004772, 0000000, 0012600, 0012601, 0062706, 0000006, 0012602, 
    /* 0005070: */ 0012603, 0012604, 0005716, 0003321, 0020027, 0000051, 0001410, 0005700, 
    /* 0005110: */ 0003263, 0005745, 0001003, 0005726, 0000257, 0000207, 0104417, 0005745, 
    /* 0005130: */ 0001003, 0005726, 0000262, 0000207, 0005716, 0002773, 0005726, 0005325, 
    /* 0005150: */ 0000653, 0104401, 0024400, 0026453, 0027452, 0000136, 0012216, 0012442, 
    /* 0005170: */ 0012776, 0012550, 0013714, 0104467, 0010146, 0104472, 0104470, 0102417, 
    /* 0005210: */ 0001022, 0012601, 0162706, 0000006, 0010600, 0104406, 0102764, 0012602, 
    /* 0005230: */ 0012603, 0012604, 0000207, 0012002, 0012003, 0012004, 0000207, 0020227, 
    /* 0005250: */ 0000056, 0001757, 0000471, 0020227, 0000106, 0001473, 0012746, 0177700, 
    /* 0005270: */ 0041602, 0010200, 0104530, 0104530, 0104472, 0104470, 0102454, 0001453, 
    /* 0005310: */ 0041602, 0060200, 0104530, 0104530, 0104472, 0104470, 0102444, 0001443, 
    /* 0005330: */ 0042602, 0060200, 0012703, 0005734, 0022300, 0001404, 0020327, 0005762, 
    /* 0005350: */ 0103773, 0000552, 0104472, 0020227, 0000050, 0001146, 0016346, 0000024, 
    /* 0005370: */ 0104536, 0102023, 0012600, 0104542, 0010002, 0010600, 0010146, 0010001, 
    /* 0005410: */ 0162706, 0000006, 0010600, 0004712, 0012602, 0012603, 0012604, 0012601, 
    /* 0005430: */ 0062706, 0000010, 0000207, 0005726, 0000517, 0021627, 0017204, 0001036, 
    /* 0005450: */ 0000751, 0104472, 0020227, 0000116, 0001107, 0104472, 0104470, 0102504, 
    /* 0005470: */ 0001503, 0104534, 0001507, 0005000, 0052702, 0060000, 0010204, 0104514, 
    /* 0005510: */ 0001473, 0005723, 0012304, 0012346, 0104534, 0104514, 0001027, 0104472, 
    /* 0005530: */ 0020227, 0000050, 0001340, 0010446, 0104536, 0102401, 0104417, 0012600, 
    /* 0005550: */ 0010546, 0104512, 0005000, 0104512, 0104550, 0010146, 0016601, 0000004, 
    /* 0005570: */ 0104536, 0102764, 0012601, 0012605, 0022626, 0000207, 0022323, 0012600, 
    /* 0005610: */ 0012346, 0012346, 0012346, 0010346, 0010046, 0104472, 0020227, 0000050, 
    /* 0005630: */ 0001036, 0104536, 0102343, 0010100, 0016601, 0000002, 0010441, 0010341, 
    /* 0005650: */ 0010241, 0012601, 0010046, 0104536, 0102731, 0012601, 0012600, 0012640, 
    /* 0005670: */ 0012640, 0012640, 0005726, 0000207, 0012601, 0104544, 0102403, 0001402, 
    /* 0005710: */ 0000167, 0177322, 0104767, 0005002, 0005003, 0005004, 0000207, 0062706, 
    /* 0005730: */ 0000012, 0000762, 0060602, 0010537, 0003756, 0016300, 0037343, 0002553, 
    /* 0005750: */ 0061246, 0027634, 0056434, 0060472, 0016266, 0015020, 0015162, 0015260, 
    /* 0005770: */ 0014260, 0013764, 0012470, 0015642, 0013372, 0010004, 0012522, 0017204, 
    /* 0006010: */ 0104526, 0102422, 0005301, 0005000, 0104534, 0001415, 0104514, 0001413, 
    /* 0006030: */ 0021627, 0004334, 0001413, 0005723, 0121127, 0000050, 0001006, 0005201, 
    /* 0006050: */ 0010446, 0104532, 0012604, 0005700, 0000207, 0005723, 0010300, 0000207, 
    /* 0006070: */ 0104544, 0102420, 0001002, 0010400, 0104546, 0010046, 0104472, 0020227, 
    /* 0006110: */ 0000075, 0001010, 0104536, 0102407, 0012600, 0010220, 0010320, 0010420, 
    /* 0006130: */ 0000167, 0174626, 0104421, 0104417, 0104536, 0102775, 0104542, 0104540, 
    /* 0006150: */ 0020227, 0000076, 0001405, 0020227, 0000075, 0001402, 0005301, 0105004, 
    /* 0006170: */ 0012702, 0006250, 0020422, 0001404, 0020227, 0006264, 0103773, 0104423, 
    /* 0006210: */ 0062702, 0171526, 0006302, 0062702, 0006264, 0010246, 0104536, 0102743, 
    /* 0006230: */ 0010146, 0010601, 0022121, 0104542, 0010600, 0104434, 0000176, 0000010, 
    /* 0006250: */ 0036076, 0036075, 0036000, 0037075, 0037000, 0036400, 0001023, 0000411, 
    /* 0006270: */ 0003421, 0000407, 0002417, 0000405, 0002015, 0000403, 0003013, 0000401, 
    /* 0006310: */ 0001411, 0062706, 0000006, 0012601, 0062706, 0000010, 0104502, 0005301, 
    /* 0006330: */ 0000167, 0174426, 0062706, 0000006, 0012601, 0062706, 0000010, 0104540, 
    /* 0006350: */ 0020427, 0052110, 0001015, 0104540, 0020427, 0042516, 0001020, 0104472, 
    /* 0006370: */ 0005301, 0104470, 0102403, 0001013, 0000167, 0175612, 0000167, 0174624, 
    /* 0006410: */ 0020427, 0043517, 0001004, 0104540, 0020427, 0052117, 0001765, 0104425, 
    /* 0006430: */ 0005046, 0012700, 0000034, 0104504, 0103506, 0104472, 0120227, 0000054, 
    /* 0006450: */ 0001434, 0120227, 0000073, 0001452, 0120227, 0000042, 0001453, 0120227, 
    /* 0006470: */ 0000072, 0001463, 0120227, 0000012, 0001460, 0005716, 0002442, 0005301, 
    /* 0006510: */ 0104536, 0102437, 0010146, 0004767, 0002174, 0010600, 0104466, 0062706, 
    /* 0006530: */ 0000024, 0012601, 0012716, 0177777, 0000734, 0016700, 0005124, 0020027, 
    /* 0006550: */ 0000070, 0002402, 0104402, 0000412, 0005400, 0003003, 0062700, 0000016, 
    /* 0006570: */ 0000774, 0112702, 0000040, 0104400, 0005300, 0003375, 0012716, 0000001, 
    /* 0006610: */ 0000710, 0104427, 0112102, 0104400, 0121127, 0000012, 0001772, 0121127, 
    /* 0006630: */ 0000042, 0001370, 0005201, 0005016, 0000674, 0005726, 0003001, 0104402, 
    /* 0006650: */ 0005301, 0000167, 0174104, 0104401, 0005046, 0004767, 0000200, 0102001, 
    /* 0006670: */ 0104445, 0005046, 0010146, 0012702, 0000077, 0104400, 0104500, 0004767, 
    /* 0006710: */ 0000052, 0102422, 0003015, 0002416, 0012601, 0005726, 0005726, 0001376, 
    /* 0006730: */ 0005301, 0005767, 0004726, 0001002, 0112711, 0000012, 0000167, 0174012, 
    /* 0006750: */ 0104765, 0000751, 0104763, 0000747, 0104761, 0000745, 0010604, 0022424, 
    /* 0006770: */ 0005724, 0005724, 0001376, 0005744, 0014400, 0001425, 0010446, 0104406, 
    /* 0007010: */ 0102424, 0012604, 0121127, 0000054, 0001410, 0121127, 0000072, 0001407, 
    /* 0007030: */ 0121127, 0000012, 0001404, 0000262, 0000207, 0005201, 0000755, 0014400, 
    /* 0007050: */ 0001773, 0000270, 0000207, 0000257, 0000207, 0005726, 0000764, 0104544, 
    /* 0007070: */ 0102424, 0001002, 0010400, 0104546, 0012602, 0010046, 0012700, 0000004, 
    /* 0007110: */ 0104504, 0103415, 0010246, 0104472, 0120227, 0000054, 0001760, 0120227, 
    /* 0007130: */ 0000072, 0001404, 0120227, 0000012, 0001401, 0000262, 0000207, 0104401, 
    /* 0007150: */ 0012746, 0000001, 0005046, 0004767, 0177704, 0102001, 0104447, 0005046, 
    /* 0007170: */ 0010146, 0016701, 0004472, 0001003, 0016701, 0004456, 0000426, 0121127, 
    /* 0007210: */ 0000012, 0001423, 0004767, 0177544, 0102427, 0002413, 0010167, 0004440, 
    /* 0007230: */ 0012601, 0005726, 0005726, 0001376, 0005726, 0001776, 0005301, 0000167, 
    /* 0007250: */ 0173510, 0005724, 0005024, 0005714, 0001375, 0104534, 0122721, 0000147, 
    /* 0007270: */ 0001746, 0020103, 0103773, 0104451, 0104453, 0104526, 0020227, 0000075, 
    /* 0007310: */ 0001117, 0005000, 0010446, 0104534, 0104514, 0001003, 0010400, 0104546, 
    /* 0007330: */ 0000402, 0010300, 0022020, 0010046, 0005000, 0104534, 0052704, 0040000, 
    /* 0007350: */ 0104514, 0001407, 0010446, 0010146, 0012704, 0000020, 0104520, 0012601, 
    /* 0007370: */ 0012604, 0010400, 0104512, 0016700, 0004256, 0104512, 0104536, 0011600, 
    /* 0007410: */ 0010220, 0010320, 0010420, 0104540, 0020427, 0052117, 0001051, 0104536, 
    /* 0007430: */ 0104550, 0121127, 0000123, 0001013, 0104540, 0020427, 0051524, 0001040, 
    /* 0007450: */ 0104540, 0020427, 0042520, 0001034, 0104536, 0104550, 0000406, 0005002, 
    /* 0007470: */ 0012703, 0040000, 0012704, 0100001, 0000770, 0011600, 0010146, 0010501, 
    /* 0007510: */ 0162701, 0000014, 0010146, 0104434, 0001406, 0002413, 0012601, 0005761, 
    /* 0007530: */ 0000010, 0002413, 0000401, 0005726, 0012601, 0022626, 0000167, 0173212, 
    /* 0007550: */ 0104455, 0012601, 0005761, 0000010, 0002767, 0012601, 0005726, 0104534, 
    /* 0007570: */ 0122127, 0000157, 0001403, 0020103, 0103773, 0104457, 0104526, 0020416, 
    /* 0007610: */ 0001367, 0005726, 0005301, 0000752, 0005000, 0104526, 0010446, 0104534, 
    /* 0007630: */ 0104514, 0001451, 0010346, 0052704, 0040000, 0104534, 0104514, 0001443, 
    /* 0007650: */ 0010146, 0022323, 0010301, 0062701, 0000006, 0016600, 0000002, 0010346, 
    /* 0007670: */ 0022020, 0010046, 0104420, 0012600, 0011603, 0010301, 0005763, 0000010, 
    /* 0007710: */ 0100003, 0104434, 0003021, 0000402, 0104434, 0002416, 0012600, 0005726, 
    /* 0007730: */ 0010046, 0005740, 0011000, 0104474, 0104510, 0010104, 0012601, 0011600, 
    /* 0007750: */ 0010446, 0022020, 0000657, 0104461, 0012601, 0062701, 0000006, 0016600, 
    /* 0007770: */ 0000002, 0022020, 0104422, 0012601, 0022626, 0000704, 0010046, 0016700, 
    /* 0010010: */ 0000036, 0016701, 0000034, 0104416, 0042700, 0100000, 0010067, 0000020, 
    /* 0010030: */ 0010001, 0011600, 0104436, 0012600, 0162760, 0000017, 0000004, 0000207, 
    /* 0010050: */ 0013507, 0000403, 0016767, 0003630, 0177766, 0052767, 0000001, 0177760, 
    /* 0010070: */ 0000167, 0172666, 0010546, 0010046, 0005020, 0005020, 0005010, 0005046, 
    /* 0010110: */ 0005046, 0005046, 0104472, 0122702, 0000105, 0001474, 0122702, 0000055, 
    /* 0010130: */ 0001512, 0122702, 0000053, 0001504, 0122702, 0000056, 0001473, 0104470, 
    /* 0010150: */ 0001125, 0162702, 0000060, 0010146, 0032766, 0000004, 0000002, 0001033, 
    /* 0010170: */ 0162706, 0000006, 0010600, 0010201, 0104436, 0016600, 0000016, 0012701, 
    /* 0010210: */ 0010660, 0104430, 0102526, 0016600, 0000016, 0010601, 0104420, 0032766, 
    /* 0010230: */ 0000010, 0000010, 0001402, 0005366, 0000012, 0062706, 0000006, 0012601, 
    /* 0010250: */ 0052716, 0000001, 0000464, 0010246, 0016603, 0000010, 0012705, 0000012, 
    /* 0010270: */ 0005002, 0005004, 0020327, 0001724, 0003100, 0104462, 0062603, 0010366, 
    /* 0010310: */ 0000006, 0000755, 0032716, 0000004, 0001061, 0052716, 0000004, 0042716, 
    /* 0010330: */ 0000001, 0000435, 0032716, 0000014, 0001051, 0052716, 0000010, 0000427, 
    /* 0010350: */ 0042716, 0000400, 0000401, 0052716, 0000400, 0032716, 0000004, 0001020, 
    /* 0010370: */ 0032716, 0000001, 0001013, 0032716, 0000030, 0001030, 0052716, 0000020, 
    /* 0010410: */ 0032716, 0000400, 0001404, 0052716, 0000100, 0000401, 0000430, 0000632, 
    /* 0010430: */ 0032716, 0000001, 0001373, 0031627, 0000040, 0001010, 0052716, 0000040, 
    /* 0010450: */ 0032716, 0000400, 0001764, 0052716, 0000200, 0000761, 0052716, 0000002, 
    /* 0010470: */ 0000755, 0062706, 0000010, 0012601, 0000771, 0022626, 0000767, 0010146, 
    /* 0010510: */ 0032766, 0000100, 0000002, 0001404, 0016600, 0000010, 0010001, 0104424, 
    /* 0010530: */ 0032766, 0000200, 0000002, 0001407, 0005466, 0000006, 0102004, 0052766, 
    /* 0010550: */ 0000002, 0000002, 0000426, 0066666, 0000004, 0000006, 0001422, 0002411, 
    /* 0010570: */ 0016600, 0000010, 0012701, 0010660, 0104430, 0005366, 0000006, 0003370, 
    /* 0010610: */ 0000410, 0016600, 0000010, 0012701, 0010660, 0104426, 0005266, 0000006, 
    /* 0010630: */ 0002770, 0012601, 0005301, 0012604, 0062706, 0000006, 0012605, 0032704, 
    /* 0010650: */ 0000002, 0001401, 0000262, 0000207, 0000000, 0050000, 0100004, 0000000, 
    /* 0010670: */ 0040000, 0100001, 0000000, 0075022, 0100024, 0040000, 0046113, 0100030, 
    /* 0010710: */ 0000000, 0040000, 0100000, 0012700, 0000012, 0005046, 0005300, 0003375, 
    /* 0010730: */ 0104542, 0012766, 0030040, 0000010, 0112766, 0000040, 0000012, 0005703, 
    /* 0010750: */ 0001546, 0003006, 0010600, 0010001, 0104424, 0112766, 0000055, 0000010, 
    /* 0010770: */ 0012701, 0010674, 0010600, 0104434, 0003014, 0012700, 0010702, 0010601, 
    /* 0011010: */ 0104434, 0002416, 0012701, 0010660, 0010600, 0104426, 0005266, 0000006, 
    /* 0011030: */ 0000764, 0012701, 0010660, 0010600, 0104430, 0005366, 0000006, 0000750, 
    /* 0011050: */ 0012701, 0010710, 0010600, 0104420, 0162766, 0100037, 0000004, 0006266, 
    /* 0011070: */ 0000002, 0006016, 0005266, 0000004, 0001372, 0010600, 0062700, 0000016, 
    /* 0011110: */ 0010601, 0010046, 0104414, 0012600, 0062700, 0000003, 0122710, 0000040, 
    /* 0011130: */ 0001403, 0005266, 0000006, 0000401, 0005200, 0062766, 0000007, 0000006, 
    /* 0011150: */ 0012701, 0000010, 0010002, 0062702, 0000007, 0005301, 0122742, 0000060, 
    /* 0011170: */ 0001774, 0010604, 0062704, 0000011, 0022766, 0000010, 0000006, 0003450, 
    /* 0011210: */ 0022766, 0177770, 0000006, 0002044, 0010103, 0005403, 0066603, 0000006, 
    /* 0011230: */ 0062703, 0000007, 0002435, 0016603, 0000006, 0002415, 0003023, 0112724, 
    /* 0011250: */ 0000056, 0112024, 0020002, 0101775, 0112724, 0000040, 0105014, 0062706, 
    /* 0011270: */ 0000010, 0016607, 0000022, 0112724, 0000056, 0112724, 0000060, 0005203, 
    /* 0011310: */ 0002774, 0000757, 0112024, 0005303, 0003375, 0020002, 0101750, 0000754, 
    /* 0011330: */ 0112724, 0000056, 0112024, 0020002, 0101775, 0112724, 0000105, 0062706, 
    /* 0011350: */ 0000006, 0011601, 0010600, 0062700, 0000014, 0010046, 0010446, 0104412, 
    /* 0011370: */ 0012604, 0012600, 0122027, 0000040, 0001775, 0124027, 0000055, 0001402, 
    /* 0011410: */ 0112724, 0000040, 0112024, 0121027, 0000040, 0001374, 0112724, 0000040, 
    /* 0011430: */ 0105014, 0005726, 0016607, 0000022, 0005000, 0004767, 0167556, 0004767, 
    /* 0011450: */ 0166756, 0001013, 0162702, 0000060, 0006300, 0060002, 0006300, 0006300, 
    /* 0011470: */ 0060200, 0032700, 0160000, 0001761, 0104441, 0005301, 0000207, 0010046, 
    /* 0011510: */ 0005046, 0010146, 0002002, 0005166, 0000002, 0010601, 0162706, 0000014, 
    /* 0011530: */ 0010600, 0104414, 0010601, 0016600, 0000020, 0062701, 0000005, 0012702, 
    /* 0011550: */ 0000007, 0112120, 0005302, 0003375, 0062706, 0000022, 0000207, 0010546, 
    /* 0011570: */ 0010046, 0005046, 0012103, 0011102, 0002004, 0005402, 0005403, 0005602, 
    /* 0011610: */ 0005216, 0012705, 0000012, 0005004, 0012746, 0177777, 0005000, 0005001, 
    /* 0011630: */ 0104464, 0010146, 0050200, 0050300, 0005700, 0001370, 0010605, 0005204, 
    /* 0011650: */ 0005725, 0002375, 0005304, 0012703, 0000013, 0160403, 0005303, 0016500, 
    /* 0011670: */ 0000002, 0005703, 0003404, 0112720, 0000040, 0005303, 0000772, 0005715, 
    /* 0011710: */ 0001403, 0112720, 0000055, 0000402, 0112720, 0000040, 0062716, 0000060, 
    /* 0011730: */ 0112620, 0005716, 0002373, 0112710, 0000040, 0062706, 0000006, 0012605, 
    /* 0011750: */ 0000207, 0010546, 0010003, 0010105, 0005002, 0005004, 0104462, 0010300, 
    /* 0011770: */ 0010201, 0012605, 0000207, 0005000, 0005001, 0012746, 0000041, 0006000, 
    /* 0012010: */ 0006001, 0006002, 0006003, 0103003, 0060501, 0005500, 0060400, 0005316, 
    /* 0012030: */ 0001366, 0005726, 0000207, 0012746, 0000040, 0010446, 0010546, 0005466, 
    /* 0012050: */ 0000002, 0005416, 0005666, 0000002, 0061601, 0005500, 0066600, 0000002, 
    /* 0012070: */ 0103445, 0005046, 0006103, 0006102, 0006101, 0006100, 0005716, 0001410, 
    /* 0012110: */ 0005016, 0066601, 0000002, 0005500, 0005516, 0066600, 0000004, 0000404, 
    /* 0012130: */ 0060501, 0005500, 0005516, 0060400, 0005516, 0005716, 0001401, 0005203, 
    /* 0012150: */ 0005366, 0000006, 0003347, 0006003, 0103404, 0060501, 0005500, 0060400, 
    /* 0012170: */ 0000241, 0006103, 0062706, 0000010, 0000242, 0000207, 0062706, 0000006, 
    /* 0012210: */ 0104773, 0000262, 0000207, 0010546, 0010046, 0012146, 0012146, 0011146, 
    /* 0012230: */ 0012002, 0012001, 0011000, 0020016, 0101412, 0010604, 0010003, 0011400, 
    /* 0012250: */ 0010324, 0010103, 0011401, 0010324, 0010203, 0011402, 0010324, 0161600, 
    /* 0012270: */ 0001431, 0100003, 0020027, 0177741, 0002005, 0016605, 0000002, 0016603, 
    /* 0012310: */ 0000004, 0000434, 0020027, 0177760, 0003007, 0062700, 0000020, 0010102, 
    /* 0012330: */ 0005001, 0005702, 0100001, 0005101, 0005700, 0001404, 0006201, 0006002, 
    /* 0012350: */ 0005200, 0001374, 0016605, 0000002, 0016603, 0000004, 0060203, 0005505, 
    /* 0012370: */ 0102421, 0060105, 0102003, 0006005, 0006003, 0005216, 0016600, 0000006, 
    /* 0012410: */ 0010001, 0010320, 0010520, 0011620, 0010100, 0062706, 0000010, 0012605, 
    /* 0012430: */ 0000167, 0000546, 0060105, 0103762, 0000756, 0010004, 0162706, 0000006, 
    /* 0012450: */ 0010600, 0104424, 0010400, 0010601, 0104420, 0062706, 0000006, 0000207, 
    /* 0012470: */ 0104432, 0005761, 0000002, 0002010, 0012102, 0012103, 0005403, 0005402, 
    /* 0012510: */ 0005603, 0010220, 0010320, 0012120, 0000207, 0104432, 0012701, 0010666, 
    /* 0012530: */ 0005760, 0000002, 0003003, 0001403, 0104424, 0000207, 0104432, 0000207, 
    /* 0012550: */ 0010546, 0010046, 0005046, 0012105, 0012104, 0005704, 0001477, 0002004, 
    /* 0012570: */ 0005404, 0005405, 0005604, 0005216, 0012003, 0012002, 0001563, 0003004, 
    /* 0012610: */ 0005402, 0005403, 0005602, 0005316, 0011101, 0005401, 0061001, 0006001, 
    /* 0012630: */ 0006101, 0102054, 0062701, 0100000, 0010146, 0010301, 0010200, 0005002, 
    /* 0012650: */ 0005003, 0006000, 0006001, 0006002, 0104464, 0005404, 0005405, 0005604, 
    /* 0012670: */ 0006301, 0006100, 0060501, 0005500, 0060400, 0002403, 0062703, 0000001, 
    /* 0012710: */ 0005502, 0000241, 0006002, 0006003, 0005216, 0005766, 0000002, 0001403, 
    /* 0012730: */ 0005402, 0005403, 0005602, 0016600, 0000004, 0010320, 0010220, 0012610, 
    /* 0012750: */ 0022626, 0012605, 0024040, 0010001, 0000167, 0000216, 0022626, 0104773, 
    /* 0012770: */ 0012605, 0000262, 0000207, 0010546, 0010046, 0012105, 0012104, 0011101, 
    /* 0013010: */ 0005046, 0005704, 0001457, 0100004, 0005404, 0005405, 0005604, 0005316, 
    /* 0013030: */ 0012003, 0012002, 0001447, 0100004, 0005402, 0005403, 0005602, 0005216, 
    /* 0013050: */ 0061001, 0006001, 0006101, 0102342, 0062701, 0100000, 0010146, 0104462, 
    /* 0013070: */ 0005216, 0006102, 0006101, 0006100, 0102402, 0005316, 0000772, 0006000, 
    /* 0013110: */ 0006001, 0005501, 0005500, 0102002, 0005216, 0000771, 0012602, 0005726, 
    /* 0013130: */ 0001403, 0005400, 0005401, 0005600, 0012603, 0010123, 0010023, 0010213, 
    /* 0013150: */ 0012605, 0000207, 0005000, 0005001, 0005002, 0005726, 0000765, 0005020, 
    /* 0013170: */ 0010120, 0012710, 0100017, 0024040, 0010001, 0012104, 0012102, 0012103, 
    /* 0013210: */ 0010301, 0005702, 0001004, 0005704, 0001002, 0005003, 0000420, 0005203, 
    /* 0013230: */ 0005303, 0006304, 0006102, 0102374, 0103010, 0001007, 0005704, 0001004, 
    /* 0013250: */ 0000261, 0006002, 0005203, 0005201, 0000261, 0006002, 0006004, 0010420, 
    /* 0013270: */ 0010220, 0010320, 0020301, 0101002, 0000242, 0000207, 0000262, 0000207, 
    /* 0013310: */ 0010102, 0010004, 0012224, 0012224, 0012224, 0000207, 0010146, 0104454, 
    /* 0013330: */ 0010600, 0016601, 0000006, 0104422, 0016601, 0000002, 0062706, 0000010, 
    /* 0013350: */ 0005401, 0000207, 0012602, 0062700, 0000006, 0014046, 0014046, 0014046, 
    /* 0013370: */ 0010207, 0012103, 0012102, 0011104, 0100021, 0024141, 0020427, 0100037, 
    /* 0013410: */ 0103337, 0162704, 0100037, 0006202, 0006003, 0005204, 0002774, 0010001, 
    /* 0013430: */ 0010320, 0010220, 0012710, 0100037, 0010100, 0000657, 0005702, 0100004, 
    /* 0013450: */ 0012701, 0010666, 0000167, 0177020, 0005020, 0005020, 0005010, 0000207, 
    /* 0013470: */ 0012102, 0012103, 0011104, 0020427, 0100017, 0101013, 0001410, 0020427, 
    /* 0013510: */ 0100000, 0103410, 0162704, 0100017, 0006203, 0005204, 0001375, 0010300, 
    /* 0013530: */ 0000207, 0104771, 0005000, 0000207, 0042120, 0026520, 0030461, 0041040, 
    /* 0013550: */ 0051501, 0041511, 0020054, 0042526, 0051522, 0047511, 0020116, 0030060, 
    /* 0013570: */ 0040467, 0005015, 0047452, 0000040, 0000000, 0000000, 0000000, 0000000, 
    /* 0013610: */ 0000000, 0000000, 0000000, 0000000, 0000000, 0000000, 0000000, 0000000, 
    /* 0013630: */ 0000000, 0000000, 0000000, 0000000, 0000000, 0000000, 0000000, 0000000, 
    /* 0013650: */ 0000000, 0000000, 0000000, 0000000, 0000000, 0000000, 0000000, 0000000, 
    /* 0013670: */ 0000000, 0000000, 0000000, 0000000, 0000001, 0000000, 0000000, 0000000, 
    /* 0013710: */ 0000001, 0013660, 0010146, 0010046, 0162706, 0000006, 0010001, 0010600, 
    /* 0013730: */ 0004767, 0000030, 0016601, 0000010, 0010600, 0104430, 0016600, 0000006, 
    /* 0013750: */ 0010601, 0004767, 0000302, 0062706, 0000012, 0000207, 0104456, 0005760, 
    /* 0013770: */ 0000002, 0003004, 0104777, 0062706, 0000004, 0000207, 0010001, 0005721, 
    /* 0014010: */ 0001014, 0022127, 0040000, 0001011, 0022127, 0100001, 0001006, 0005020, 
    /* 0014030: */ 0005020, 0005020, 0062706, 0000004, 0000207, 0016046, 0000004, 0062716, 
    /* 0014050: */ 0100000, 0012760, 0100000, 0000004, 0011601, 0162706, 0000006, 0010600, 
    /* 0014070: */ 0104436, 0016600, 0000010, 0104454, 0012701, 0014214, 0104422, 0010600, 
    /* 0014110: */ 0012701, 0014214, 0104420, 0016600, 0000016, 0010601, 0104426, 0012704, 
    /* 0014130: */ 0014230, 0016600, 0000016, 0012703, 0000004, 0104450, 0104452, 0016600, 
    /* 0014150: */ 0000016, 0012701, 0014506, 0104422, 0062706, 0000006, 0010600, 0012701, 
    /* 0014170: */ 0014222, 0104430, 0010601, 0016600, 0000010, 0104420, 0062706, 0000014, 
    /* 0014210: */ 0000242, 0000207, 0074626, 0055202, 0100000, 0005776, 0054271, 0100000, 
    /* 0014230: */ 0125112, 0046414, 0077777, 0007411, 0063120, 0077777, 0066333, 0052525, 
    /* 0014250: */ 0100000, 0177772, 0077777, 0100001, 0104456, 0026027, 0000004, 0100016, 
    /* 0014270: */ 0101241, 0012701, 0014500, 0104446, 0016600, 0000002, 0012701, 0014506, 
    /* 0014310: */ 0104430, 0016600, 0000002, 0104454, 0104454, 0010600, 0012701, 0014514, 
    /* 0014330: */ 0104420, 0010600, 0010001, 0104424, 0005266, 0000012, 0016600, 0000016, 
    /* 0014350: */ 0010001, 0104430, 0016600, 0000016, 0012701, 0014530, 0104420, 0012700, 
    /* 0014370: */ 0014522, 0104454, 0010600, 0016601, 0000024, 0104426, 0010600, 0010001, 
    /* 0014410: */ 0062701, 0000006, 0104420, 0010601, 0010100, 0062700, 0000014, 0104426, 
    /* 0014430: */ 0062706, 0000014, 0010600, 0012701, 0010666, 0104420, 0010600, 0010001, 
    /* 0014450: */ 0104430, 0010601, 0016600, 0000010, 0104432, 0016600, 0000010, 0066660, 
    /* 0014470: */ 0000006, 0000004, 0000167, 0177504, 0016624, 0056125, 0100001, 0005776, 
    /* 0014510: */ 0054271, 0077777, 0037347, 0117741, 0100004, 0041565, 0132306, 0100012, 
    /* 0014530: */ 0026570, 0074056, 0100006, 0162766, 0000002, 0000002, 0016600, 0000010, 
    /* 0014550: */ 0016601, 0000012, 0010046, 0104430, 0062766, 0000006, 0000014, 0011600, 
    /* 0014570: */ 0016601, 0000014, 0104420, 0005766, 0000004, 0001407, 0011600, 0016601, 
    /* 0014610: */ 0000010, 0104430, 0005366, 0000004, 0000757, 0011600, 0016601, 0000006, 
    /* 0014630: */ 0104430, 0005726, 0012603, 0062706, 0000026, 0010346, 0000207, 0012603, 
    /* 0014650: */ 0005046, 0010146, 0010046, 0104432, 0010307, 0012603, 0000772, 0012601, 
    /* 0014670: */ 0104454, 0010146, 0010446, 0010346, 0010046, 0010001, 0104430, 0012600, 
    /* 0014710: */ 0012603, 0012604, 0012601, 0104454, 0010446, 0010046, 0010646, 0062716, 
    /* 0014730: */ 0000006, 0010646, 0062716, 0000016, 0010346, 0010107, 0016600, 0000002, 
    /* 0014750: */ 0104430, 0012666, 0000002, 0011601, 0104442, 0010046, 0011601, 0162706, 
    /* 0014770: */ 0000006, 0010600, 0104436, 0010601, 0016600, 0000010, 0104422, 0062706, 
    /* 0015010: */ 0000006, 0016646, 0000004, 0000207, 0104444, 0005760, 0000002, 0002005, 
    /* 0015030: */ 0010001, 0104424, 0005266, 0000004, 0000404, 0001003, 0062706, 0000006, 
    /* 0015050: */ 0000207, 0012701, 0015206, 0104446, 0012602, 0042702, 0177774, 0006302, 
    /* 0015070: */ 0062702, 0015176, 0011207, 0012701, 0010666, 0011600, 0104422, 0011600, 
    /* 0015110: */ 0010001, 0104424, 0000404, 0012701, 0010666, 0011600, 0104422, 0011600, 
    /* 0015130: */ 0012704, 0015214, 0012703, 0000006, 0104450, 0104452, 0005766, 0000004, 
    /* 0015150: */ 0001735, 0011600, 0010001, 0104424, 0000731, 0104444, 0012701, 0015252, 
    /* 0015170: */ 0104420, 0011600, 0000712, 0015126, 0015076, 0015106, 0015116, 0140671, 
    /* 0015210: */ 0050574, 0100000, 0017676, 0106516, 0077756, 0175316, 0051777, 0077764, 
    /* 0015230: */ 0156214, 0131513, 0077771, 0167376, 0050632, 0077775, 0006165, 0126521, 
    /* 0015250: */ 0100000, 0166516, 0062207, 0100001, 0005046, 0104444, 0005760, 0000002, 
    /* 0015270: */ 0001530, 0002004, 0005266, 0000006, 0010001, 0104424, 0012701, 0010666, 
    /* 0015310: */ 0011600, 0104434, 0002017, 0005266, 0000004, 0012700, 0010666, 0104454, 
    /* 0015330: */ 0010600, 0016601, 0000006, 0104426, 0010601, 0016600, 0000006, 0104432, 
    /* 0015350: */ 0062706, 0000006, 0012701, 0015562, 0011600, 0104434, 0003404, 0005046, 
    /* 0015370: */ 0005046, 0005046, 0000430, 0012700, 0015576, 0104454, 0016600, 0000006, 
    /* 0015410: */ 0104454, 0012701, 0015570, 0104430, 0016600, 0000014, 0012701, 0010666, 
    /* 0015430: */ 0104422, 0010600, 0012701, 0015570, 0104420, 0016600, 0000014, 0010601, 
    /* 0015450: */ 0104426, 0062706, 0000006, 0016600, 0000006, 0012704, 0015604, 0012703, 
    /* 0015470: */ 0000005, 0104450, 0104452, 0010601, 0016600, 0000006, 0104420, 0062706, 
    /* 0015510: */ 0000006, 0005766, 0000004, 0001407, 0011600, 0012701, 0015252, 0104422, 
    /* 0015530: */ 0011600, 0010001, 0104424, 0005766, 0000006, 0001403, 0011600, 0010001, 
    /* 0015550: */ 0104424, 0062706, 0000010, 0000242, 0000207, 0050574, 0042230, 0077777, 
    /* 0015570: */ 0165640, 0067331, 0100001, 0044336, 0041405, 0100000, 0113440, 0060462, 
    /* 0015610: */ 0077775, 0107717, 0133556, 0077776, 0155646, 0063141, 0077776, 0131012, 
    /* 0015630: */ 0125252, 0077777, 0177776, 0077777, 0100000, 0104444, 0005760, 0000002, 
    /* 0015650: */ 0001456, 0002004, 0005266, 0000004, 0010001, 0104424, 0005066, 0000002, 
    /* 0015670: */ 0011600, 0022020, 0062710, 0100000, 0006210, 0005566, 0000002, 0011046, 
    /* 0015710: */ 0012710, 0100000, 0016600, 0000002, 0104454, 0012701, 0016076, 0104430, 
    /* 0015730: */ 0016600, 0000010, 0012701, 0016070, 0104420, 0104460, 0104460, 0104460, 
    /* 0015750: */ 0066660, 0000006, 0000004, 0062706, 0000010, 0005766, 0000002, 0001403, 
    /* 0015770: */ 0012701, 0016062, 0104430, 0005766, 0000004, 0001401, 0104775, 0062706, 
    /* 0016010: */ 0000006, 0000242, 0000207, 0010600, 0005720, 0104454, 0010600, 0016601, 
    /* 0016030: */ 0000020, 0104426, 0010601, 0016600, 0000020, 0104420, 0016600, 0000020, 
    /* 0016050: */ 0005360, 0000004, 0062706, 0000006, 0000207, 0074626, 0055202, 0100001, 
    /* 0016070: */ 0125672, 0065324, 0077777, 0067102, 0045612, 0100000, 0016706, 0175602, 
    /* 0016110: */ 0104402, 0012767, 0016126, 0161664, 0016701, 0161424, 0000402, 0005267, 
    /* 0016130: */ 0001332, 0012767, 0016146, 0161644, 0024646, 0012701, 0160000, 0022626, 
    /* 0016150: */ 0014111, 0162701, 0000302, 0010167, 0001300, 0012700, 0013540, 0104552, 
    /* 0016170: */ 0122702, 0000114, 0001433, 0122702, 0000104, 0001435, 0122702, 0000105, 
    /* 0016210: */ 0001430, 0122702, 0000110, 0001432, 0122702, 0000012, 0001503, 0104470, 
    /* 0016230: */ 0001030, 0005301, 0104410, 0010067, 0001206, 0104472, 0122702, 0000012, 
    /* 0016250: */ 0001471, 0122702, 0000054, 0001371, 0104472, 0000742, 0005267, 0001162, 
    /* 0016270: */ 0000764, 0005267, 0001160, 0005267, 0001152, 0000757, 0005367, 0001150, 
    /* 0016310: */ 0000754, 0005067, 0001132, 0005067, 0001130, 0005067, 0001126, 0005067, 
    /* 0016330: */ 0001124, 0005067, 0001122, 0012700, 0017304, 0104552, 0010367, 0001104, 
    /* 0016350: */ 0003405, 0012700, 0017234, 0104552, 0010367, 0001072, 0005767, 0001074, 
    /* 0016370: */ 0001005, 0012700, 0017350, 0104552, 0010367, 0001046, 0012700, 0017401, 
    /* 0016410: */ 0104552, 0010367, 0001042, 0012700, 0017437, 0104466, 0104500, 0104410, 
    /* 0016430: */ 0010067, 0001014, 0066767, 0001024, 0001010, 0005767, 0001004, 0003407, 
    /* 0016450: */ 0012767, 0177560, 0175226, 0012767, 0177564, 0175222, 0000406, 0012767, 
    /* 0016470: */ 0177550, 0175210, 0012767, 0177554, 0175204, 0016701, 0000754, 0016700, 
    /* 0016510: */ 0000736, 0001414, 0000300, 0006300, 0006300, 0006300, 0042700, 0003777, 
    /* 0016530: */ 0020027, 0020000, 0103666, 0020001, 0101001, 0010001, 0010106, 0012767, 
    /* 0016550: */ 0000006, 0161230, 0010167, 0175132, 0012701, 0016104, 0005767, 0000664, 
    /* 0016570: */ 0003433, 0005067, 0167136, 0005067, 0167134, 0005067, 0167132, 0005067, 
    /* 0016610: */ 0167136, 0012701, 0015020, 0005767, 0000634, 0003416, 0005067, 0167112, 
    /* 0016630: */ 0005067, 0167110, 0012700, 0000136, 0006200, 0012701, 0013714, 0012702, 
    /* 0016650: */ 0017046, 0012221, 0005300, 0003375, 0005767, 0000574, 0002036, 0012767, 
    /* 0016670: */ 0016702, 0161160, 0010167, 0175002, 0000000, 0016701, 0174774, 0012700, 
    /* 0016710: */ 0000030, 0006200, 0012702, 0017204, 0010167, 0167062, 0010167, 0166514, 
    /* 0016730: */ 0012703, 0000016, 0060103, 0010367, 0161112, 0012221, 0005300, 0003375, 
    /* 0016750: */ 0016706, 0161074, 0010667, 0174732, 0000402, 0005067, 0166772, 0010167, 
    /* 0016770: */ 0174670, 0016705, 0174664, 0112725, 0000012, 0005067, 0174674, 0000167, 
    /* 0017010: */ 0164100, 0104466, 0104500, 0104472, 0005003, 0120227, 0000131, 0001002, 
    /* 0017030: */ 0005303, 0000207, 0120227, 0000116, 0001374, 0005203, 0000207, 0010046, 
    /* 0017050: */ 0104454, 0010100, 0104454, 0012701, 0010666, 0016600, 0000014, 0104432, 
    /* 0017070: */ 0010600, 0010046, 0010046, 0062716, 0000006, 0016600, 0000002, 0010001, 
    /* 0017110: */ 0004737, 0013372, 0005766, 0000006, 0003005, 0002416, 0062706, 0000022, 
    /* 0017130: */ 0000242, 0000207, 0011601, 0016600, 0000020, 0104430, 0012701, 0010666, 
    /* 0017150: */ 0016600, 0000002, 0104422, 0000756, 0011601, 0016600, 0000020, 0104426, 
    /* 0017170: */ 0012701, 0010666, 0016600, 0000002, 0104420, 0000744, 0062706, 0000010, 
    /* 0017210: */ 0010100, 0012601, 0013702, 0000050, 0000112, 0012602, 0012603, 0012604, 
    /* 0017230: */ 0000137, 0005430, 0047504, 0054440, 0052517, 0051040, 0050505, 0044525, 
    /* 0017250: */ 0042522, 0042440, 0050130, 0047440, 0020122, 0047514, 0020107, 0043050, 
    /* 0017270: */ 0047514, 0052101, 0047111, 0020107, 0024536, 0000077, 0047504, 0054440, 
    /* 0017310: */ 0052517, 0047040, 0042505, 0020104, 0044124, 0020105, 0054105, 0042524, 
    /* 0017330: */ 0042116, 0042105, 0043040, 0047125, 0052103, 0047511, 0051516, 0000077, 
    /* 0017350: */ 0044510, 0044107, 0051455, 0042520, 0042105, 0051040, 0040505, 0042504, 
    /* 0017370: */ 0027522, 0052520, 0041516, 0037510, 0051400, 0052105, 0052440, 0020120, 
    /* 0017410: */ 0044124, 0020105, 0054105, 0042524, 0047122, 0046101, 0043040, 0047125, 
    /* 0017430: */ 0052103, 0047511, 0037516, 0046400, 0046505, 0051117, 0037531, 0000000, 
    /* 0017450: */ 0000000, 0000000, 0000000, 0000000, 0000000, 0000000, 0000000
};

/* Link all records into one list */
const PROGMEM Pdp11DataRecordList basicRecordList = {
    0016104,    // execution entry address
    3      ,    // record count
    &basicRecordListRecord00,
    &basicRecordListRecord01,
    &basicRecordListRecord02
};

