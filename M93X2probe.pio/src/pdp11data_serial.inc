/* ..\M93X2probe.pio\src\pdp11data_serial.inc - format records to hold loadable PDP-11 binary code
   Loads only into first 56k page
   Platform    : Arduino
   Memory space: PROGMEM
   Generated by: pdp11code2c -ml serial.lst -cs ..\M93X2probe.pio\src\pdp11data_serial.inc -cid serialRecordList --entryaddress start
   Generated at: 2024-07-25 14:27:25
   Contact     : ioerg.hoppe@gmail.com
*/
#include "pdp11data.h"

/* define non-contiguous blocks */
static const PROGMEM Pdp11DataRecord serialRecordListRecord00 = {
    0000000,     // start address
    2      ,     // word count
    /* 0000000: */ 0000137, 0001000
};

static const PROGMEM Pdp11DataRecord serialRecordListRecord01 = {
    0000024,     // start address
    2      ,     // word count
    /* 0000024: */ 0001000, 0000340
};

static const PROGMEM Pdp11DataRecord serialRecordListRecord02 = {
    0001000,     // start address
    76     ,     // word count
    /* 0001000: */ 0012706, 0000776, 0012701, 0001126, 0004737, 0001054, 0004737, 0001110, 
    /* 0001020: */ 0042700, 0177600, 0120027, 0000003, 0001403, 0004737, 0001070, 0000766, 
    /* 0001040: */ 0012701, 0001211, 0004737, 0001054, 0000000, 0000752, 0112100, 0001403, 
    /* 0001060: */ 0004737, 0001070, 0000773, 0000207, 0012704, 0177560, 0110064, 0000006, 
    /* 0001100: */ 0105764, 0000004, 0100375, 0000207, 0012704, 0177560, 0105714, 0100376, 
    /* 0001120: */ 0016400, 0000002, 0000207, 0062510, 0066154, 0026157, 0053440, 0071157, 
    /* 0001140: */ 0062154, 0006441, 0052012, 0070171, 0062145, 0061440, 0060550, 0071562, 
    /* 0001160: */ 0060440, 0062562, 0062440, 0064143, 0062557, 0026144, 0057040, 0020103, 
    /* 0001200: */ 0040510, 0052114, 0027163, 0005015, 0006400, 0043412, 0067557, 0020144, 
    /* 0001220: */ 0074542, 0020545, 0005015, 0000000
};

/* Link all records into one list */
const PROGMEM Pdp11DataRecordList serialRecordList = {
    0001000,    // execution entry address
    3      ,    // record count
    &serialRecordListRecord00,
    &serialRecordListRecord01,
    &serialRecordListRecord02
};

